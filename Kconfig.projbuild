## components/app_core/Kconfig.orb
```kconfig
menu "Mode Configuration"

choice ORB_DEFAULT_MODE
    prompt "Default mode"
    default ORB_DEFAULT_MODE_HYBRID_AI

config ORB_DEFAULT_MODE_OFFLINE_SCRIPTED
    bool "offline_scripted"

config ORB_DEFAULT_MODE_HYBRID_AI
    bool "hybrid_ai"

config ORB_DEFAULT_MODE_INSTALLATION_SLAVE
    bool "installation_slave"
endchoice

config ORB_MODE_SWITCH_TIMEOUT_MS
    int "Mode switch timeout (ms)"
    range 10 30000
    default 1500

config ORB_OFFLINE_COOLDOWN_MS
    int "Offline session cooldown (ms)"
    range 100 30000
    default 1200

config ORB_HYBRID_REJECT_THRESHOLD_PERMILLE
    int "Hybrid speech reject threshold (permille)"
    range 0 1000
    default 380
    help
        Threshold used when local reject policy is enabled.
        Remote-only hybrid flow can ignore this parameter.

config ORB_HYBRID_MIC_CAPTURE_DEFAULT_MS
    int "Hybrid microphone capture default (ms)"
    range 1000 60000
    default 5000
    help
        Default microphone capture duration used by hybrid mode.
        Runtime config can override this value.

config ORB_HYBRID_UNKNOWN_RETRY_MAX
    int "Hybrid unknown retry attempts"
    range 0 2
    default 1
    help
        Number of in-session repeat attempts when speech intent is unknown/uncertain.
        0 disables retry loop; 2 allows up to two retries.

config ORB_AURA_TRACK1_ASSET_ID
    int "Aura mode track #1 asset id"
    range 1 65535
    default 1

config ORB_AURA_TRACK2_ASSET_ID
    int "Aura mode track #2 asset id"
    range 1 65535
    default 2

config ORB_AURA_TRACK_GAP_MS
    int "Aura mode gap between track #1 and #2 (ms)"
    range 0 30000
    default 1200

config ORB_OFFLINE_GRUMBLE_ENABLE
    bool "Enable offline idle grumble reactions"
    default y
    help
        In offline aura submode, repeated touch-down events in idle can
        probabilistically trigger a short "grumble" voice line.

config ORB_OFFLINE_GRUMBLE_ASSET_ID
    int "Offline grumble audio asset id"
    range 1 65535
    default 3
    depends on ORB_OFFLINE_GRUMBLE_ENABLE

config ORB_OFFLINE_GRUMBLE_MIN_TOUCHES
    int "Offline grumble minimum touches in window"
    range 1 50
    default 3
    depends on ORB_OFFLINE_GRUMBLE_ENABLE

config ORB_OFFLINE_GRUMBLE_WINDOW_MS
    int "Offline grumble touch window (ms)"
    range 200 120000
    default 6000
    depends on ORB_OFFLINE_GRUMBLE_ENABLE

config ORB_OFFLINE_GRUMBLE_COOLDOWN_MS
    int "Offline grumble cooldown (ms)"
    range 500 300000
    default 20000
    depends on ORB_OFFLINE_GRUMBLE_ENABLE

config ORB_OFFLINE_GRUMBLE_BASE_PROB_PCT
    int "Offline grumble base probability (%)"
    range 0 100
    default 15
    depends on ORB_OFFLINE_GRUMBLE_ENABLE

config ORB_OFFLINE_GRUMBLE_STEP_PROB_PCT
    int "Offline grumble probability step per extra touch (%)"
    range 0 100
    default 10
    depends on ORB_OFFLINE_GRUMBLE_ENABLE

config ORB_OFFLINE_GRUMBLE_MAX_PROB_PCT
    int "Offline grumble maximum probability (%)"
    range 0 100
    default 65
    depends on ORB_OFFLINE_GRUMBLE_ENABLE

config ORB_OFFLINE_GRUMBLE_FADE_OUT_MS
    int "Offline grumble LED fade-out duration (ms)"
    range 50 5000
    default 900
    depends on ORB_OFFLINE_GRUMBLE_ENABLE

config ORB_OFFLINE_LOTTERY_TEAMS_COUNT
    int "Offline lottery teams count"
    range 2 4
    default 4

config ORB_OFFLINE_LOTTERY_PARTICIPANTS_TOTAL
    int "Offline lottery participants per round"
    range 1 128
    default 17

config ORB_OFFLINE_LOTTERY_TOUCH_DEBOUNCE_MS
    int "Offline lottery touch debounce for sorting start (ms)"
    range 50 3000
    default 260

config ORB_OFFLINE_LOTTERY_TRIGGER_DEBOUNCE_MS
    int "Offline lottery trigger cooldown after assignment (ms)"
    range 0 5000
    default 450

config ORB_OFFLINE_LOTTERY_RESULT_COOLDOWN_MS
    int "Offline lottery result cooldown (ms)"
    range 100 10000
    default 1200

config ORB_OFFLINE_LOTTERY_SCENE_IDLE_ID
    int "Offline lottery idle scene id"
    range 1 255
    default 10

config ORB_OFFLINE_LOTTERY_SCENE_SORTING_ID
    int "Offline lottery sorting scene id"
    range 1 255
    default 11

config ORB_OFFLINE_LOTTERY_SCENE_RESULT_ID
    int "Offline lottery result scene id"
    range 1 255
    default 8

config ORB_OFFLINE_PROPHECY_SCENE_IDLE_ID
    int "Offline prophecy idle scene id"
    range 1 255
    default 4

config ORB_OFFLINE_PROPHECY_SCENE_ACTIVE_ID
    int "Offline prophecy active scene id"
    range 1 255
    default 5

config ORB_OFFLINE_PROPHECY_SCENE_COOLDOWN_ID
    int "Offline prophecy cooldown scene id"
    range 1 255
    default 1

config ORB_OFFLINE_PROPHECY_COOLDOWN_MS
    int "Offline prophecy cooldown (ms)"
    range 100 30000
    default 1500

endmenu

menu "Logging Configuration"

config ORB_TOUCH_ONLY_LOG_MODE
    bool "Touch-only INFO logs after startup (others WARN)"
    default n
    help
        Reduces runtime log noise for touch bring-up:
        keeps touch_service at INFO and sets all other tags to WARN.

config ORB_MEM_MONITOR_ENABLE
    bool "Enable periodic memory monitor logs"
    default n
    help
        Logs free heap and largest free block for total heap, internal SRAM,
        and PSRAM at fixed intervals.

config ORB_MEM_MONITOR_PERIOD_MS
    int "Memory monitor period (ms)"
    range 1000 3600000
    default 60000
    depends on ORB_MEM_MONITOR_ENABLE

endmenu

menu "Tasking and Queue Configuration"

config ORB_APP_CONTROL_TASK_STACK_SIZE
    int "app_control_task stack size"
    range 2048 16384
    default 6144

config ORB_APP_CONTROL_TASK_PRIORITY
    int "app_control_task priority"
    range 1 24
    default 10

config ORB_TOUCH_TASK_STACK_SIZE
    int "touch_task stack size"
    range 2048 12288
    default 3072

config ORB_TOUCH_TASK_PRIORITY
    int "touch_task priority"
    range 1 24
    default 8

config ORB_LED_TASK_STACK_SIZE
    int "led_task stack size"
    range 2048 12288
    default 3072

config ORB_LED_TASK_PRIORITY
    int "led_task priority"
    range 1 24
    default 7

config ORB_AUDIO_TASK_STACK_SIZE
    int "audio_task stack size"
    range 4096 32768
    default 16384

config ORB_AUDIO_TASK_PRIORITY
    int "audio_task priority"
    range 1 24
    default 8

config ORB_AI_TASK_STACK_SIZE
    int "ai_task stack size"
    range 2048 16384
    default 6144

config ORB_AI_TASK_PRIORITY
    int "ai_task priority"
    range 1 24
    default 8

config ORB_APP_EVENT_QUEUE_LENGTH
    int "app event queue length"
    range 4 128
    default 24

config ORB_LED_COMMAND_QUEUE_LENGTH
    int "LED command queue length"
    range 4 128
    default 16

config ORB_AUDIO_COMMAND_QUEUE_LENGTH
    int "Audio command queue length"
    range 4 128
    default 16

config ORB_AI_COMMAND_QUEUE_LENGTH
    int "AI command queue length"
    range 4 128
    default 8

config ORB_QUEUE_SEND_TIMEOUT_MS
    int "Queue send timeout (ms)"
    range 1 10000
    default 50

config ORB_QUEUE_RECV_TIMEOUT_MS
    int "Queue receive timeout (ms)"
    range 1 10000
    default 100

config ORB_AUDIO_STOP_TIMEOUT_MS
    int "Audio stop timeout (ms)"
    range 10 30000
    default 1000

config ORB_AI_REQUEST_TIMEOUT_MS
    int "AI request timeout (ms)"
    range 10 60000
    default 5000

endmenu
```

## components/bsp/Kconfig.orb
```kconfig
menu "Board Configuration"

config ORB_DEVICE_NAME
    string "Device name"
    default "orb-s3"

config ORB_BOARD_LED_GPIO
    int "Board LED GPIO"
    default 2

config ORB_STATUS_GPIO
    int "Status/Service GPIO"
    default 4

config ORB_LED_DATA_GPIO
    int "LED data GPIO"
    default 48

config ORB_AMP_ENABLE_GPIO
    int "Amplifier enable GPIO"
    default 21

menu "Mode Button Configuration"

config ORB_MODE_BUTTON_ENABLE
    bool "Enable hardware mode button (active-low to GND)"
    default y

config ORB_MODE_BUTTON_GPIO
    int "Mode button GPIO"
    range 0 48
    default 14
    depends on ORB_MODE_BUTTON_ENABLE

config ORB_MODE_BUTTON_PULLUP_ENABLE
    bool "Enable internal pull-up"
    default y
    depends on ORB_MODE_BUTTON_ENABLE

config ORB_MODE_BUTTON_POLL_MS
    int "Button poll period (ms)"
    range 1 100
    default 10
    depends on ORB_MODE_BUTTON_ENABLE

config ORB_MODE_BUTTON_DEBOUNCE_MS
    int "Button debounce (ms)"
    range 5 200
    default 20
    depends on ORB_MODE_BUTTON_ENABLE

config ORB_MODE_BUTTON_TASK_STACK_SIZE
    int "Mode button task stack size"
    range 1536 4096
    default 3072
    depends on ORB_MODE_BUTTON_ENABLE

config ORB_MODE_BUTTON_TASK_PRIORITY
    int "Mode button task priority"
    range 1 24
    default 5
    depends on ORB_MODE_BUTTON_ENABLE

endmenu

menu "Submode Button Configuration"

config ORB_SUBMODE_BUTTON_ENABLE
    bool "Enable hardware submode button (active-low to GND)"
    default y

config ORB_SUBMODE_BUTTON_GPIO
    int "Submode button GPIO"
    range 0 48
    default 15
    depends on ORB_SUBMODE_BUTTON_ENABLE

config ORB_SUBMODE_BUTTON_PULLUP_ENABLE
    bool "Enable internal pull-up"
    default y
    depends on ORB_SUBMODE_BUTTON_ENABLE

config ORB_SUBMODE_BUTTON_POLL_MS
    int "Submode button poll period (ms)"
    range 1 100
    default 10
    depends on ORB_SUBMODE_BUTTON_ENABLE

config ORB_SUBMODE_BUTTON_DEBOUNCE_MS
    int "Submode button debounce (ms)"
    range 5 200
    default 25
    depends on ORB_SUBMODE_BUTTON_ENABLE

config ORB_SUBMODE_BUTTON_TASK_STACK_SIZE
    int "Submode button task stack size"
    range 1536 4096
    default 3072
    depends on ORB_SUBMODE_BUTTON_ENABLE

config ORB_SUBMODE_BUTTON_TASK_PRIORITY
    int "Submode button task priority"
    range 1 24
    default 5
    depends on ORB_SUBMODE_BUTTON_ENABLE

endmenu

endmenu
```

## components/services_ai/Kconfig.orb
```kconfig
menu "AI Configuration"

config ORB_ENABLE_AI
    bool "Enable AI service"
    default y

config ORB_AI_PROMPT_MAX_LEN
    int "AI prompt max length"
    range 32 512
    default 128

endmenu
```

## components/services_audio/Kconfig.orb
```kconfig
menu "Audio Configuration"

choice ORB_AUDIO_DAC_PROFILE
    prompt "I2S DAC profile"
    default ORB_AUDIO_DAC_PCM5102A

config ORB_AUDIO_DAC_PCM5102A
    bool "PCM5102A"

config ORB_AUDIO_DAC_MAX98357A
    bool "MAX98357A / MAX9xxxx-compatible"
endchoice

config ORB_AUDIO_I2S_BCLK_GPIO
    int "I2S BCLK pin"
    default 18

config ORB_AUDIO_I2S_WS_GPIO
    int "I2S WS/LRCK pin"
    default 17

config ORB_AUDIO_I2S_DOUT_GPIO
    int "I2S DOUT pin"
    default 16

config ORB_AUDIO_I2S_SAMPLE_RATE_HZ
    int "I2S sample rate (Hz)"
    range 8000 96000
    default 44100

config ORB_AUDIO_I2S_MONO
    bool "I2S mono output"
    default y

config ORB_AUDIO_I2S_DMA_DESC_NUM
    int "I2S DMA descriptor count"
    range 4 24
    default 8

config ORB_AUDIO_I2S_DMA_FRAME_NUM
    int "I2S DMA frame count per descriptor"
    range 64 1024
    default 256

config ORB_AUDIO_USE_AMP_ENABLE_GPIO
    bool "Use amplifier enable GPIO"
    default y

config ORB_AUDIO_AMP_ENABLE_ACTIVE_HIGH
    bool "Amplifier enable is active-high"
    default y
    depends on ORB_AUDIO_USE_AMP_ENABLE_GPIO

config ORB_AUDIO_DEFAULT_VOLUME
    int "Default audio volume"
    range 0 100
    default 70

config ORB_AUDIO_REAL_MP3_ENABLE
    bool "Enable real MP3 playback from SD (Helix)"
    default y

config ORB_AUDIO_ASSET1_PATH
    string "Asset #1 path"
    default "/sdcard/1.mp3"
    depends on ORB_AUDIO_REAL_MP3_ENABLE

config ORB_AUDIO_ASSET2_PATH
    string "Asset #2 path"
    default "/sdcard/2.mp3"
    depends on ORB_AUDIO_REAL_MP3_ENABLE

config ORB_AUDIO_ASSET3_PATH
    string "Asset #3 path"
    default "/sdcard/3.mp3"
    depends on ORB_AUDIO_REAL_MP3_ENABLE

config ORB_AUDIO_GRUMBLE_DIR
    string "Offline grumble tracks folder"
    default "/sdcard/audio/grumble"
    depends on ORB_AUDIO_REAL_MP3_ENABLE

config ORB_AUDIO_LOTTERY_SORTING_DIR
    string "Offline lottery sorting tracks folder"
    default "/sdcard/audio/lottery/sorting"
    depends on ORB_AUDIO_REAL_MP3_ENABLE

config ORB_AUDIO_LOTTERY_TEAM1_DIR
    string "Offline lottery team #1 tracks folder"
    default "/sdcard/audio/lottery/team1"
    depends on ORB_AUDIO_REAL_MP3_ENABLE

config ORB_AUDIO_LOTTERY_TEAM2_DIR
    string "Offline lottery team #2 tracks folder"
    default "/sdcard/audio/lottery/team2"
    depends on ORB_AUDIO_REAL_MP3_ENABLE

config ORB_AUDIO_LOTTERY_TEAM3_DIR
    string "Offline lottery team #3 tracks folder"
    default "/sdcard/audio/lottery/team3"
    depends on ORB_AUDIO_REAL_MP3_ENABLE

config ORB_AUDIO_LOTTERY_TEAM4_DIR
    string "Offline lottery team #4 tracks folder"
    default "/sdcard/audio/lottery/team4"
    depends on ORB_AUDIO_REAL_MP3_ENABLE

config ORB_AUDIO_LOTTERY_FINISHED_PATH
    string "Offline lottery finished phrase path"
    default "/sdcard/audio/lottery/finished.mp3"
    depends on ORB_AUDIO_REAL_MP3_ENABLE

config ORB_AUDIO_PROPHECY_ROOT_DIR
    string "Offline prophecy root folder"
    default "/sdcard/audio/oracle"
    depends on ORB_AUDIO_REAL_MP3_ENABLE

config ORB_AUDIO_HYBRID_START_DIR
    string "Hybrid intro phrases folder"
    default "/sdcard/audio/hybrid/start"
    depends on ORB_AUDIO_REAL_MP3_ENABLE

config ORB_AUDIO_HYBRID_FAIL_DIR
    string "Hybrid local fail fallback folder"
    default "/sdcard/audio/hybrid/fail"
    depends on ORB_AUDIO_REAL_MP3_ENABLE

config ORB_AUDIO_PROPHECY_BG_WAV_PATH
    string "Prophecy background WAV path"
    default "/sdcard/audio/backgrounds/oracle.wav"
    depends on ORB_AUDIO_REAL_MP3_ENABLE

config ORB_AUDIO_PROPHECY_BG_GAIN_PERMILLE
    int "Prophecy background gain (permille)"
    range 10 1000
    default 260
    depends on ORB_AUDIO_REAL_MP3_ENABLE

config ORB_AUDIO_PROPHECY_BG_FADE_IN_MS
    int "Prophecy background fade-in (ms)"
    range 0 10000
    default 2000
    depends on ORB_AUDIO_REAL_MP3_ENABLE

config ORB_AUDIO_PROPHECY_BG_FADE_OUT_MS
    int "Prophecy background fade-out (ms)"
    range 0 15000
    default 4000
    depends on ORB_AUDIO_REAL_MP3_ENABLE

config ORB_AUDIO_MP3_INPUT_BUFFER_SIZE
    int "MP3 input buffer size (bytes)"
    range 2048 32768
    default 8192
    depends on ORB_AUDIO_REAL_MP3_ENABLE

config ORB_AUDIO_MP3_READ_CHUNK_SIZE
    int "MP3 read chunk size (bytes)"
    range 256 4096
    default 2048
    depends on ORB_AUDIO_REAL_MP3_ENABLE

config ORB_AUDIO_TEST_TONE_ENABLE
    bool "Enable test tone generator in simulated playback"
    default y

config ORB_AUDIO_TEST_TONE_FREQ_HZ
    int "Test tone frequency (Hz)"
    range 80 4000
    default 660
    depends on ORB_AUDIO_TEST_TONE_ENABLE

config ORB_AUDIO_TEST_TONE_LEVEL_PERCENT
    int "Test tone level (%)"
    range 1 80
    default 18
    depends on ORB_AUDIO_TEST_TONE_ENABLE

config ORB_AUDIO_TEST_TONE_CHUNK_MS
    int "Test tone chunk size (ms)"
    range 5 100
    default 10
    depends on ORB_AUDIO_TEST_TONE_ENABLE

config ORB_AUDIO_I2S_WRITE_TIMEOUT_MS
    int "I2S write timeout (ms)"
    range 0 5000
    default 0

config ORB_AUDIO_SIM_PLAYBACK_MS
    int "Simulated playback duration (ms)"
    range 50 10000
    default 900

config ORB_AUDIO_REACTIVE_EVENT_ENABLE
    bool "Publish audio level events for LED reactivity"
    default y

config ORB_AUDIO_REACTIVE_UPDATE_MS
    int "Audio level publish period (ms)"
    range 10 500
    default 25
    depends on ORB_AUDIO_REACTIVE_EVENT_ENABLE

config ORB_AUDIO_REACTIVE_LEVEL_SCALE
    int "Audio level normalization scale (PCM abs units)"
    range 1000 32767
    default 7000
    depends on ORB_AUDIO_REACTIVE_EVENT_ENABLE

config ORB_AUDIO_REACTIVE_NOISE_GATE
    int "Audio reactive noise gate (0..64)"
    range 0 64
    default 5
    depends on ORB_AUDIO_REACTIVE_EVENT_ENABLE

config ORB_AUDIO_REACTIVE_MIN_SPAN
    int "Audio reactive adaptive span (metric units)"
    range 10 2000
    default 110
    depends on ORB_AUDIO_REACTIVE_EVENT_ENABLE

endmenu
```
