## components/services_config/Kconfig.orb
```kconfig
menu "Config Configuration"

config ORB_CONFIG_PERSIST_TO_NVS
    bool "Persist runtime config to NVS"
    default y

config ORB_CONFIG_NVS_NAMESPACE
    string "NVS namespace for runtime config"
    default "orb_cfg"
    depends on ORB_CONFIG_PERSIST_TO_NVS

menu "Offline Runtime Defaults"

choice ORB_CFG_DEFAULT_OFFLINE_SUBMODE
    prompt "Default offline submode"
    default ORB_CFG_DEFAULT_OFFLINE_SUBMODE_AURA

config ORB_CFG_DEFAULT_OFFLINE_SUBMODE_AURA
    bool "aura"

config ORB_CFG_DEFAULT_OFFLINE_SUBMODE_LOTTERY
    bool "lottery"

config ORB_CFG_DEFAULT_OFFLINE_SUBMODE_PROPHECY
    bool "prophecy"
endchoice

config ORB_CFG_DEFAULT_AURA_INTRO_DIR
    string "Aura intro tracks folder"
    default "/sdcard/audio/aura/intro"

config ORB_CFG_DEFAULT_AURA_RESPONSE_DIR
    string "Aura response tracks folder"
    default "/sdcard/audio/aura/response"

config ORB_CFG_DEFAULT_AURA_GAP_MS
    int "Aura gap between intro and response (ms)"
    range 0 30000
    default ORB_AURA_TRACK_GAP_MS

endmenu

endmenu
```

## components/services_led/Kconfig.orb
```kconfig
menu "LED Configuration"

config ORB_LED_DEFAULT_BRIGHTNESS
    int "Default LED brightness"
    range 0 255
    default 96

config ORB_LED_POWER_LIMIT_ENABLE
    bool "Enable LED current limiter"
    default y

config ORB_LED_MAX_CURRENT_MA
    int "LED max current (mA)"
    range 100 20000
    default 2000
    depends on ORB_LED_POWER_LIMIT_ENABLE

config ORB_LED_MAX_COLOR_CHANNEL_MA
    int "Max current per color channel at value=255 (mA)"
    range 1 30
    default 20
    depends on ORB_LED_POWER_LIMIT_ENABLE

config ORB_LED_IDLE_CURRENT_MA
    int "Idle current per LED pixel (mA)"
    range 0 10
    default 1
    depends on ORB_LED_POWER_LIMIT_ENABLE

config ORB_LED_ENABLE_OUTPUT
    bool "Enable WS2812 LED output backend"
    default y

config ORB_LED_MATRIX_WIDTH
    int "LED matrix width"
    range 1 64
    default 16

config ORB_LED_MATRIX_HEIGHT
    int "LED matrix height"
    range 1 64
    default 16

choice ORB_LED_MATRIX_ROTATION
    prompt "Matrix rotation"
    default ORB_LED_MATRIX_ROTATE_90_CW

config ORB_LED_MATRIX_ROTATE_0
    bool "0 degrees"

config ORB_LED_MATRIX_ROTATE_90_CW
    bool "90 degrees CW"

config ORB_LED_MATRIX_ROTATE_180
    bool "180 degrees"

config ORB_LED_MATRIX_ROTATE_90_CCW
    bool "90 degrees CCW"
endchoice

config ORB_LED_MATRIX_SERPENTINE
    bool "Matrix uses serpentine row wiring"
    default y

config ORB_LED_MATRIX_FLIP_X
    bool "Flip matrix X axis"
    default n

config ORB_LED_MATRIX_FLIP_Y
    bool "Flip matrix Y axis"
    default n

config ORB_LED_FRAME_INTERVAL_MS
    int "LED frame interval (ms)"
    range 10 100
    default 33

config ORB_LED_BREATHE_PERIOD_MS
    int "Idle breathe period (ms)"
    range 200 10000
    default 2200

config ORB_LED_TOUCH_OVERLAY_ENABLE
    bool "Enable touch zone brightness overlay"
    default y

config ORB_LED_TOUCH_OVERLAY_INTENSITY
    int "Touch overlay max intensity"
    range 0 255
    default 255
    depends on ORB_LED_TOUCH_OVERLAY_ENABLE

config ORB_LED_TOUCH_OVERLAY_MAX_BOOST_PERCENT
    int "Touch overlay max brightness boost (%)"
    range 0 500
    default 320
    depends on ORB_LED_TOUCH_OVERLAY_ENABLE

config ORB_LED_TOUCH_OVERLAY_LIFT_MAX
    int "Touch overlay max additive lift"
    range 0 255
    default 28
    depends on ORB_LED_TOUCH_OVERLAY_ENABLE

config ORB_LED_TOUCH_OVERLAY_FADE_MS
    int "Touch overlay fade-out (ms)"
    range 0 3000
    default 450
    depends on ORB_LED_TOUCH_OVERLAY_ENABLE

config ORB_LED_TOUCH_OVERLAY_BACKGROUND_DIM_PERCENT
    int "Background dim while touch active (%)"
    range 10 100
    default 60
    depends on ORB_LED_TOUCH_OVERLAY_ENABLE

config ORB_LED_AUDIO_REACTIVE_ENABLE
    bool "Enable audio-reactive global brightness modulation"
    default y

config ORB_LED_AUDIO_REACTIVE_MIN_BRIGHTNESS_PERCENT
    int "Audio-reactive minimum gain (%)"
    range 1 300
    default 30
    depends on ORB_LED_AUDIO_REACTIVE_ENABLE

config ORB_LED_AUDIO_REACTIVE_MAX_BRIGHTNESS_PERCENT
    int "Audio-reactive maximum gain (%)"
    range 1 400
    default 240
    depends on ORB_LED_AUDIO_REACTIVE_ENABLE

config ORB_LED_AUDIO_REACTIVE_TIMEOUT_MS
    int "Audio-reactive stale timeout (ms)"
    range 20 3000
    default 220
    depends on ORB_LED_AUDIO_REACTIVE_ENABLE

config ORB_LED_FIRE_COOLING
    int "Fire2012 cooling factor"
    range 20 200
    default 55

config ORB_LED_FIRE_SPARKING
    int "Fire2012 sparking chance (0..255)"
    range 0 255
    default 120

config ORB_LED_SPARKLE_DENSITY
    int "Sparkle spawn chance (0..255)"
    range 0 255
    default 56

config ORB_LED_RMT_RESOLUTION_HZ
    int "RMT resolution for WS2812 (Hz)"
    range 1000000 40000000
    default 10000000
    depends on ORB_LED_ENABLE_OUTPUT

config ORB_LED_RMT_MEM_BLOCK_SYMBOLS
    int "RMT memory block symbols"
    range 64 1024
    default 128
    depends on ORB_LED_ENABLE_OUTPUT

config ORB_LED_RMT_TX_QUEUE_DEPTH
    int "RMT TX queue depth"
    range 1 16
    default 2
    depends on ORB_LED_ENABLE_OUTPUT

config ORB_LED_TX_TIMEOUT_MS
    int "LED TX wait timeout (ms)"
    range 1 1000
    default 50
    depends on ORB_LED_ENABLE_OUTPUT

endmenu
```

## components/services_mic/Kconfig.orb
```kconfig
menu "Microphone Configuration"

config ORB_ENABLE_MIC
    bool "Enable microphone service (INMP441 I2S RX)"
    default y

config ORB_MIC_I2S_PORT
    int "Microphone I2S port"
    range 0 1
    default 1
    depends on ORB_ENABLE_MIC

config ORB_MIC_I2S_BCLK_GPIO
    int "Microphone I2S BCLK pin"
    range 0 48
    default 6
    depends on ORB_ENABLE_MIC

config ORB_MIC_I2S_WS_GPIO
    int "Microphone I2S WS/LRCK pin"
    range 0 48
    default 7
    depends on ORB_ENABLE_MIC

config ORB_MIC_I2S_DIN_GPIO
    int "Microphone I2S DIN pin"
    range 0 48
    default 8
    depends on ORB_ENABLE_MIC

config ORB_MIC_I2S_USE_RIGHT_SLOT
    bool "Read right channel slot (otherwise left)"
    default n
    depends on ORB_ENABLE_MIC

config ORB_MIC_SAMPLE_RATE_HZ
    int "Microphone sample rate (Hz)"
    range 8000 48000
    default 16000
    depends on ORB_ENABLE_MIC

config ORB_MIC_I2S_DMA_DESC_NUM
    int "Microphone I2S DMA descriptor count"
    range 4 24
    default 8
    depends on ORB_ENABLE_MIC

config ORB_MIC_I2S_DMA_FRAME_NUM
    int "Microphone I2S DMA frame count per descriptor"
    range 64 1024
    default 256
    depends on ORB_ENABLE_MIC

config ORB_MIC_TASK_STACK_SIZE
    int "mic_task stack size"
    range 3072 16384
    default 10240
    depends on ORB_ENABLE_MIC

config ORB_MIC_TASK_PRIORITY
    int "mic_task priority"
    range 1 24
    default 8
    depends on ORB_ENABLE_MIC

config ORB_MIC_TASK_CORE
    int "mic_task core (0/1)"
    range 0 1
    default 0
    depends on ORB_ENABLE_MIC && !FREERTOS_UNICORE
    help
        Core affinity for I2S capture/state task. Recommended: core 0.

config ORB_MIC_COMMAND_QUEUE_LENGTH
    int "Microphone command queue length"
    range 2 32
    default 8
    depends on ORB_ENABLE_MIC

config ORB_MIC_CAPTURE_DEFAULT_MS
    int "Default microphone capture duration (ms)"
    range 100 60000
    default 4000
    depends on ORB_ENABLE_MIC

config ORB_MIC_READ_CHUNK_SAMPLES
    int "Microphone read chunk (samples)"
    range 64 1024
    default 256
    depends on ORB_ENABLE_MIC

config ORB_MIC_READ_TIMEOUT_MS
    int "Microphone I2S read timeout (ms)"
    range 1 1000
    default 30
    depends on ORB_ENABLE_MIC

config ORB_MIC_ACTIVE_LOOP_DELAY_MS
    int "mic_task active-loop delay (ms)"
    range 0 20
    default 1
    depends on ORB_ENABLE_MIC
    help
        Small cooperative delay while capture is active. Prevents mic_task
        from starving IDLE task on dual-core under sustained I2S readiness.
        Set to 0 to use taskYIELD() only.

config ORB_MIC_INPUT_SHIFT
    int "Microphone sample shift to PCM16 domain"
    range 4 16
    default 13
    depends on ORB_ENABLE_MIC
    help
        INMP441 delivers 24-bit samples. This shift converts raw I2S sample
        values into a PCM16-like range used for level metrics.

config ORB_MIC_WS_ENABLE
    bool "Enable WebSocket streaming for mic capture"
    default y
    depends on ORB_ENABLE_MIC
    help
        When enabled, mic_task streams captured PCM16 chunks to an external
        WebSocket server (for example Raspberry Pi speech service) and can
        consume intent classification result from the server.

config ORB_MIC_WS_URL
    string "Mic WebSocket URL"
    default "ws://192.168.4.2:8765/mic"
    depends on ORB_ENABLE_MIC && ORB_MIC_WS_ENABLE

config ORB_MIC_WS_CONNECT_TIMEOUT_MS
    int "Mic WebSocket connect timeout (ms)"
    range 100 10000
    default 1500
    depends on ORB_ENABLE_MIC && ORB_MIC_WS_ENABLE

config ORB_MIC_WS_SEND_TIMEOUT_MS
    int "Mic WebSocket send timeout (ms)"
    range 1 1000
    default 200
    depends on ORB_ENABLE_MIC && ORB_MIC_WS_ENABLE

config ORB_MIC_WS_SEND_RETRY_COUNT
    int "Mic WebSocket send retries"
    range 0 10
    default 6
    depends on ORB_ENABLE_MIC && ORB_MIC_WS_ENABLE

config ORB_MIC_WS_SEND_RETRY_BACKOFF_MS
    int "Mic WebSocket send retry backoff (ms)"
    range 1 200
    default 20
    depends on ORB_ENABLE_MIC && ORB_MIC_WS_ENABLE

config ORB_MIC_WS_RESULT_TIMEOUT_MS
    int "Mic WebSocket result timeout after capture end (ms)"
    range 50 10000
    default 2000
    depends on ORB_ENABLE_MIC && ORB_MIC_WS_ENABLE

config ORB_MIC_WS_LOG_RESULTS
    bool "Log raw WebSocket intent payload"
    default n
    depends on ORB_ENABLE_MIC && ORB_MIC_WS_ENABLE

config ORB_MIC_WS_TTS_TIMEOUT_MS
    int "Mic WS TTS stream timeout (ms)"
    range 1000 60000
    default 15000
    depends on ORB_ENABLE_MIC && ORB_MIC_WS_ENABLE

config ORB_MIC_WS_TTS_VOICE
    string "Mic WS TTS voice hint"
    default "ruslan"
    depends on ORB_ENABLE_MIC && ORB_MIC_WS_ENABLE

endmenu
```

## components/services_mqtt/Kconfig.orb
```kconfig
menu "MQTT Configuration"

config ORB_ENABLE_MQTT
    bool "Enable MQTT service"
    default n
    depends on ORB_ENABLE_NETWORK

config ORB_MQTT_BASE_TOPIC
    string "MQTT base topic"
    default "orb/device"

endmenu
```

## components/services_network/Kconfig.orb
```kconfig
menu "Network Configuration"

config ORB_ENABLE_NETWORK
    bool "Enable network service"
    default y

choice ORB_NETWORK_MODE_POLICY_OFFLINE
    prompt "Offline Mode Network Policy"
    default ORB_NETWORK_OFFLINE_USE_SOFTAP
    depends on ORB_ENABLE_NETWORK

config ORB_NETWORK_OFFLINE_USE_NONE
    bool "No Wi-Fi in offline mode"

config ORB_NETWORK_OFFLINE_USE_SOFTAP
    bool "Local SoftAP only (no external network)"
endchoice

choice ORB_NETWORK_MODE_POLICY_HYBRID
    prompt "Hybrid AI Mode Network Policy"
    default ORB_NETWORK_HYBRID_USE_STA
    depends on ORB_ENABLE_NETWORK

config ORB_NETWORK_HYBRID_USE_NONE
    bool "No Wi-Fi in hybrid mode"

config ORB_NETWORK_HYBRID_USE_STA
    bool "STA client (connect to router)"
endchoice

choice ORB_NETWORK_MODE_POLICY_INSTALLATION
    prompt "Installation Mode Network Policy"
    default ORB_NETWORK_INSTALLATION_USE_STA
    depends on ORB_ENABLE_NETWORK

config ORB_NETWORK_INSTALLATION_USE_NONE
    bool "No Wi-Fi in installation mode"

config ORB_NETWORK_INSTALLATION_USE_STA
    bool "STA client (connect to router)"

config ORB_NETWORK_INSTALLATION_USE_SOFTAP
    bool "SoftAP mode"
endchoice

config ORB_NETWORK_HOSTNAME
    string "STA hostname"
    default "orb-s3"
    depends on ORB_ENABLE_NETWORK

config ORB_NETWORK_DISABLE_WIFI_PS
    bool "Disable Wi-Fi power-save"
    default y
    depends on ORB_ENABLE_NETWORK

config ORB_NETWORK_STA_CONNECT_TIMEOUT_MS
    int "STA connect timeout (ms)"
    range 1000 120000
    default 15000
    depends on ORB_ENABLE_NETWORK

config ORB_NETWORK_STA_RETRY_MAX
    int "STA reconnect retries"
    range 0 20
    default 5
    depends on ORB_ENABLE_NETWORK

config ORB_NETWORK_EVENT_POST_TIMEOUT_MS
    int "App event post timeout from network callbacks (ms)"
    range 1 200
    default 10
    depends on ORB_ENABLE_NETWORK

config ORB_NETWORK_APSTA_SMART_FROM_NVS
    bool "Smart APSTA startup from NVS STA credentials"
    default y
    depends on ORB_ENABLE_NETWORK
    help
        If enabled and mode policy requests APSTA, network manager first checks
        whether STA credentials were persisted in NVS. If yes, it starts STA-only
        (no setup AP). If no credentials are present in NVS, APSTA is kept so
        provisioning UI can stay available.

menu "STA Configuration"
    depends on ORB_ENABLE_NETWORK

config ORB_NETWORK_STA_SSID
    string "STA SSID"
    default ""

config ORB_NETWORK_STA_PASSWORD
    string "STA Password"
    default ""

endmenu

menu "SoftAP Configuration"
    depends on ORB_ENABLE_NETWORK

config ORB_NETWORK_AP_SSID
    string "SoftAP SSID"
    default "orb-offline"

config ORB_NETWORK_AP_PASSWORD
    string "SoftAP password (empty => open)"
    default "orbmagic42"

config ORB_NETWORK_AP_CHANNEL
    int "SoftAP channel"
    range 1 13
    default 6

config ORB_NETWORK_AP_MAX_CONNECTIONS
    int "SoftAP max stations"
    range 1 10
    default 4

config ORB_NETWORK_AP_HIDE_SSID
    bool "Hide SoftAP SSID"
    default n

endmenu

endmenu
```

## components/services_ota/Kconfig.orb
```kconfig
menu "OTA Configuration"

config ORB_ENABLE_OTA
    bool "Enable OTA service"
    default n
    depends on ORB_ENABLE_NETWORK

config ORB_OTA_ALLOW_HTTP
    bool "Allow HTTP OTA URL (unsafe, for local testing only)"
    default n
    depends on ORB_ENABLE_OTA

config ORB_OTA_URL_MAX_LEN
    int "Maximum OTA URL length"
    range 64 512
    default 192
    depends on ORB_ENABLE_OTA

endmenu
```

## components/services_storage/Kconfig.orb
```kconfig
menu "Storage Configuration"

config ORB_ENABLE_STORAGE_SD
    bool "Enable SD card storage service"
    default y

if ORB_ENABLE_STORAGE_SD

config ORB_STORAGE_AUTO_MOUNT
    bool "Auto-mount SD on boot"
    default y

config ORB_STORAGE_MOUNT_POINT
    string "Mount point"
    default "/sdcard"

config ORB_STORAGE_MAX_OPEN_FILES
    int "Max open files"
    range 1 16
    default 5

config ORB_STORAGE_FORMAT_IF_MOUNT_FAILED
    bool "Format SD if mount fails"
    default n

choice ORB_STORAGE_SPI_HOST
    prompt "SPI host for SD"
    default ORB_STORAGE_SPI_HOST_SPI2

config ORB_STORAGE_SPI_HOST_SPI2
    bool "SPI2_HOST"

config ORB_STORAGE_SPI_HOST_SPI3
    bool "SPI3_HOST"
endchoice

config ORB_STORAGE_SPI_MOSI_GPIO
    int "SD SPI MOSI GPIO"
    default 11

config ORB_STORAGE_SPI_MISO_GPIO
    int "SD SPI MISO GPIO"
    default 13

config ORB_STORAGE_SPI_SCLK_GPIO
    int "SD SPI SCLK GPIO"
    default 12

config ORB_STORAGE_SPI_CS_GPIO
    int "SD SPI CS GPIO"
    default 10

config ORB_STORAGE_SPI_CLOCK_KHZ
    int "SD SPI clock (kHz)"
    range 400 40000
    default 10000

config ORB_STORAGE_READ_ONLY
    bool "Mount SD as read-only"
    default n

endif

endmenu
```
