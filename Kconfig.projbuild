## components/services_touch/Kconfig.orb
```kconfig
menu "Touch Configuration"

config ORB_TOUCH_ENABLE_REAL
    bool "Enable real capacitive touch service"
    default y

config ORB_TOUCH_ZONE0_CHANNEL
    int "Touch zone 0 channel"
    range 1 1
    default 1
    depends on ORB_TOUCH_ENABLE_REAL

config ORB_TOUCH_ZONE1_CHANNEL
    int "Touch zone 1 channel"
    range 2 2
    default 2
    depends on ORB_TOUCH_ENABLE_REAL

config ORB_TOUCH_ZONE2_CHANNEL
    int "Touch zone 2 channel"
    range 3 3
    default 3
    depends on ORB_TOUCH_ENABLE_REAL

config ORB_TOUCH_ZONE3_CHANNEL
    int "Touch zone 3 channel"
    range 4 4
    default 4
    depends on ORB_TOUCH_ENABLE_REAL

config ORB_TOUCH_POLL_PERIOD_MS
    int "Touch poll period (ms)"
    range 5 200
    default 8
    depends on ORB_TOUCH_ENABLE_REAL

config ORB_TOUCH_STOP_TIMEOUT_MS
    int "Touch task stop timeout (ms)"
    range 100 10000
    default 1200

config ORB_TOUCH_CALIBRATION_SAMPLES
    int "Touch startup calibration samples"
    range 8 200
    default 24
    depends on ORB_TOUCH_ENABLE_REAL

config ORB_TOUCH_DEBOUNCE_COUNT
    int "Touch debounce count"
    range 1 20
    default 2
    depends on ORB_TOUCH_ENABLE_REAL

config ORB_TOUCH_RELEASE_DEBOUNCE_COUNT
    int "Touch release debounce count"
    range 1 20
    default 2
    depends on ORB_TOUCH_ENABLE_REAL

config ORB_TOUCH_STUCK_PRESS_TIMEOUT_MS
    int "Touch stuck press timeout (ms)"
    range 0 30000
    default 0
    depends on ORB_TOUCH_ENABLE_REAL

config ORB_TOUCH_HOLD_EVENT_ENABLE
    bool "Enable touch hold event"
    default y
    depends on ORB_TOUCH_ENABLE_REAL

config ORB_TOUCH_HOLD_TIME_MS
    int "Touch hold time (ms)"
    range 100 10000
    default 5000
    depends on ORB_TOUCH_HOLD_EVENT_ENABLE

config ORB_TOUCH_THRESHOLD_PERCENT
    int "Touch threshold percent of baseline"
    range 1 50
    default 3
    depends on ORB_TOUCH_ENABLE_REAL

config ORB_TOUCH_THRESHOLD_MIN_DELTA
    int "Touch minimum threshold delta"
    range 10 5000
    default 60
    depends on ORB_TOUCH_ENABLE_REAL

config ORB_TOUCH_RELEASE_THRESHOLD_PERCENT
    int "Release threshold (% of touch threshold)"
    range 10 95
    default 45
    depends on ORB_TOUCH_ENABLE_REAL

config ORB_TOUCH_FILTER_SMOOTH_SHIFT
    int "Raw filter smoothing shift"
    range 1 8
    default 1
    depends on ORB_TOUCH_ENABLE_REAL

config ORB_TOUCH_BASELINE_SMOOTH_SHIFT
    int "Baseline smoothing shift"
    range 2 10
    default 6
    depends on ORB_TOUCH_ENABLE_REAL

config ORB_TOUCH_DIAG_LOG_ENABLE
    bool "Enable touch diagnostic logs"
    default n
    depends on ORB_TOUCH_ENABLE_REAL

config ORB_TOUCH_DIAG_LOG_PERIOD_MS
    int "Touch diagnostic log period (ms)"
    range 500 60000
    default 2000
    depends on ORB_TOUCH_DIAG_LOG_ENABLE

endmenu
```

## components/services_web/Kconfig.orb
```kconfig
menu "Web Configuration"

config ORB_ENABLE_WEB
    bool "Enable web service"
    default y
    depends on ORB_ENABLE_NETWORK

config ORB_WEB_PORT
    int "Web server port"
    range 1 65535
    default 80

config ORB_WEB_MAX_URI_HANDLERS
    int "HTTP max URI handlers"
    range 16 96
    default 40
    depends on ORB_ENABLE_WEB
    help
        Must be >= number of registered portal + REST routes.
        If too small, web server start fails with ESP_ERR_HTTPD_HANDLERS_FULL.

config ORB_WEB_SERVER_STACK_SIZE
    int "HTTP server task stack size"
    range 4096 16384
    default 8192
    depends on ORB_ENABLE_WEB
    help
        Increase this if REST handlers use larger JSON payloads.

config ORB_WEB_USE_PSRAM_BUFFERS
    bool "Allocate web response buffers in PSRAM first"
    default y
    depends on ORB_ENABLE_WEB
    help
        When enabled, shared JSON buffers are allocated from PSRAM first
        and fall back to internal RAM if unavailable.

config ORB_WEB_SHARED_JSON_BUF_SIZE
    int "Shared JSON buffer size (bytes)"
    range 2048 16384
    default 8192
    depends on ORB_ENABLE_WEB
    help
        Shared response buffer used by status/config/network/offline handlers.
        Increase if JSON responses grow.

endmenu
```

## main/Kconfig.projbuild
```kconfig
menu "Orb Device Configuration"

rsource "../components/bsp/Kconfig.orb"
rsource "../components/services_touch/Kconfig.orb"
rsource "../components/services_led/Kconfig.orb"
rsource "../components/services_audio/Kconfig.orb"
rsource "../components/services_mic/Kconfig.orb"
rsource "../components/services_network/Kconfig.orb"
rsource "../components/services_mqtt/Kconfig.orb"
rsource "../components/services_ai/Kconfig.orb"
rsource "../components/services_web/Kconfig.orb"
rsource "../components/services_ota/Kconfig.orb"
rsource "../components/app_core/Kconfig.orb"
rsource "../components/services_config/Kconfig.orb"
rsource "../components/services_storage/Kconfig.orb"

endmenu
```

## sdkconfig.defaults
```kconfig
CONFIG_PARTITION_TABLE_CUSTOM=y
# CONFIG_PARTITION_TABLE_SINGLE_APP is not set
# CONFIG_PARTITION_TABLE_SINGLE_APP_LARGE is not set
# CONFIG_PARTITION_TABLE_TWO_OTA is not set
CONFIG_PARTITION_TABLE_CUSTOM_FILENAME="partitions.csv"
CONFIG_PARTITION_TABLE_FILENAME="partitions.csv"
CONFIG_PARTITION_TABLE_OFFSET=0x8000
CONFIG_PARTITION_TABLE_MD5=y

CONFIG_ORB_DEVICE_NAME="orb-s3"
CONFIG_ORB_BOARD_LED_GPIO=2
CONFIG_ORB_STATUS_GPIO=4
CONFIG_ORB_LED_DATA_GPIO=48
CONFIG_ORB_AMP_ENABLE_GPIO=21
CONFIG_ORB_AUDIO_I2S_BCLK_GPIO=18
CONFIG_ORB_AUDIO_I2S_WS_GPIO=17
CONFIG_ORB_AUDIO_I2S_DOUT_GPIO=16
CONFIG_ORB_MIC_I2S_BCLK_GPIO=6
CONFIG_ORB_MIC_I2S_WS_GPIO=7
CONFIG_ORB_MIC_I2S_DIN_GPIO=8
CONFIG_ORB_AUDIO_DAC_PCM5102A=y
# CONFIG_ORB_AUDIO_DAC_MAX98357A is not set
CONFIG_ORB_AUDIO_I2S_SAMPLE_RATE_HZ=44100
CONFIG_ORB_AUDIO_I2S_MONO=y
CONFIG_ORB_AUDIO_I2S_DMA_DESC_NUM=8
CONFIG_ORB_AUDIO_I2S_DMA_FRAME_NUM=256
CONFIG_ORB_AUDIO_USE_AMP_ENABLE_GPIO=y
CONFIG_ORB_AUDIO_AMP_ENABLE_ACTIVE_HIGH=y
CONFIG_ORB_AUDIO_DEFAULT_VOLUME=70
CONFIG_ORB_AUDIO_TEST_TONE_ENABLE=y
CONFIG_ORB_AUDIO_TEST_TONE_FREQ_HZ=660
CONFIG_ORB_AUDIO_TEST_TONE_LEVEL_PERCENT=18
CONFIG_ORB_AUDIO_TEST_TONE_CHUNK_MS=10
CONFIG_ORB_AUDIO_I2S_WRITE_TIMEOUT_MS=0
CONFIG_ORB_AUDIO_SIM_PLAYBACK_MS=900
CONFIG_ORB_ENABLE_STORAGE_SD=y
CONFIG_ORB_STORAGE_AUTO_MOUNT=y
CONFIG_ORB_STORAGE_MOUNT_POINT="/sdcard"
CONFIG_ORB_STORAGE_MAX_OPEN_FILES=5
# CONFIG_ORB_STORAGE_FORMAT_IF_MOUNT_FAILED is not set
CONFIG_ORB_STORAGE_SPI_HOST_SPI2=y
# CONFIG_ORB_STORAGE_SPI_HOST_SPI3 is not set
CONFIG_ORB_STORAGE_SPI_MOSI_GPIO=11
CONFIG_ORB_STORAGE_SPI_MISO_GPIO=13
CONFIG_ORB_STORAGE_SPI_SCLK_GPIO=12
CONFIG_ORB_STORAGE_SPI_CS_GPIO=10
CONFIG_ORB_STORAGE_SPI_CLOCK_KHZ=10000
# CONFIG_ORB_STORAGE_READ_ONLY is not set

# FATFS long file names are required for folders like
# /sdcard/audio/oracle/understanding/mysterious
# CONFIG_FATFS_LFN_NONE is not set
CONFIG_FATFS_LFN_HEAP=y
# CONFIG_FATFS_LFN_STACK is not set
CONFIG_FATFS_MAX_LFN=255

CONFIG_ORB_LED_DEFAULT_BRIGHTNESS=96
CONFIG_ORB_LED_POWER_LIMIT_ENABLE=y
CONFIG_ORB_LED_MAX_CURRENT_MA=2000
CONFIG_ORB_LED_MAX_COLOR_CHANNEL_MA=20
CONFIG_ORB_LED_IDLE_CURRENT_MA=1
CONFIG_ORB_LED_MATRIX_WIDTH=16
CONFIG_ORB_LED_MATRIX_HEIGHT=16
CONFIG_ORB_LED_MATRIX_ROTATE_90_CW=y
# CONFIG_ORB_LED_MATRIX_ROTATE_0 is not set
# CONFIG_ORB_LED_MATRIX_ROTATE_180 is not set
# CONFIG_ORB_LED_MATRIX_ROTATE_90_CCW is not set
CONFIG_ORB_LED_MATRIX_SERPENTINE=y
# CONFIG_ORB_LED_MATRIX_FLIP_X is not set
# CONFIG_ORB_LED_MATRIX_FLIP_Y is not set
CONFIG_ORB_LED_FRAME_INTERVAL_MS=16
CONFIG_ORB_LED_BREATHE_PERIOD_MS=2200
CONFIG_ORB_LED_TOUCH_OVERLAY_ENABLE=y
CONFIG_ORB_LED_TOUCH_OVERLAY_INTENSITY=255
CONFIG_ORB_LED_TOUCH_OVERLAY_MAX_BOOST_PERCENT=320
CONFIG_ORB_LED_TOUCH_OVERLAY_LIFT_MAX=28
CONFIG_ORB_LED_TOUCH_OVERLAY_FADE_MS=450
CONFIG_ORB_LED_TOUCH_OVERLAY_BACKGROUND_DIM_PERCENT=60
CONFIG_ORB_LED_FIRE_COOLING=55
CONFIG_ORB_LED_FIRE_SPARKING=120
CONFIG_ORB_LED_SPARKLE_DENSITY=56
CONFIG_ORB_LED_ENABLE_OUTPUT=y
CONFIG_ORB_LED_RMT_RESOLUTION_HZ=10000000
CONFIG_ORB_LED_RMT_MEM_BLOCK_SYMBOLS=128
CONFIG_ORB_LED_RMT_TX_QUEUE_DEPTH=2
CONFIG_ORB_LED_TX_TIMEOUT_MS=50
CONFIG_ORB_TOUCH_ENABLE_REAL=y
CONFIG_ORB_TOUCH_ZONE0_CHANNEL=1
CONFIG_ORB_TOUCH_ZONE1_CHANNEL=2
CONFIG_ORB_TOUCH_ZONE2_CHANNEL=3
CONFIG_ORB_TOUCH_ZONE3_CHANNEL=4
CONFIG_ORB_TOUCH_POLL_PERIOD_MS=8
CONFIG_ORB_TOUCH_CALIBRATION_SAMPLES=24
CONFIG_ORB_TOUCH_DEBOUNCE_COUNT=2
CONFIG_ORB_TOUCH_RELEASE_DEBOUNCE_COUNT=2
CONFIG_ORB_TOUCH_STUCK_PRESS_TIMEOUT_MS=0
CONFIG_ORB_TOUCH_HOLD_EVENT_ENABLE=y
CONFIG_ORB_TOUCH_HOLD_TIME_MS=1000
CONFIG_ORB_TOUCH_THRESHOLD_PERCENT=3
CONFIG_ORB_TOUCH_THRESHOLD_MIN_DELTA=60
CONFIG_ORB_TOUCH_RELEASE_THRESHOLD_PERCENT=45

CONFIG_ORB_TOUCH_FILTER_SMOOTH_SHIFT=1
CONFIG_ORB_TOUCH_BASELINE_SMOOTH_SHIFT=6

CONFIG_ORB_OFFLINE_COOLDOWN_MS=1200
CONFIG_ORB_AURA_TRACK1_ASSET_ID=1
CONFIG_ORB_AURA_TRACK2_ASSET_ID=2
CONFIG_ORB_AURA_TRACK_GAP_MS=1200
CONFIG_ORB_ENABLE_NETWORK=y
CONFIG_ORB_NETWORK_OFFLINE_USE_SOFTAP=y
# CONFIG_ORB_NETWORK_OFFLINE_USE_NONE is not set
CONFIG_ORB_NETWORK_HYBRID_USE_STA=y
# CONFIG_ORB_NETWORK_HYBRID_USE_NONE is not set
# CONFIG_ORB_NETWORK_INSTALLATION_USE_NONE is not set
CONFIG_ORB_NETWORK_INSTALLATION_USE_STA=y
# CONFIG_ORB_NETWORK_INSTALLATION_USE_SOFTAP is not set
CONFIG_ORB_NETWORK_HOSTNAME="orb-s3"
CONFIG_ORB_NETWORK_DISABLE_WIFI_PS=y
CONFIG_ORB_NETWORK_START_TIMEOUT_MS=3000
CONFIG_ORB_NETWORK_STA_CONNECT_TIMEOUT_MS=15000
CONFIG_ORB_NETWORK_STA_RETRY_MAX=5
CONFIG_ORB_NETWORK_EVENT_POST_TIMEOUT_MS=10
CONFIG_ORB_NETWORK_STA_SSID=""
CONFIG_ORB_NETWORK_STA_PASSWORD=""
CONFIG_ORB_NETWORK_AP_SSID="orb-offline"
CONFIG_ORB_NETWORK_AP_PASSWORD="orbmagic42"
CONFIG_ORB_NETWORK_AP_CHANNEL=6
CONFIG_ORB_NETWORK_AP_MAX_CONNECTIONS=4
# CONFIG_ORB_NETWORK_AP_HIDE_SSID is not set
CONFIG_ORB_ENABLE_MQTT=y
CONFIG_ORB_ENABLE_AI=y
CONFIG_ORB_ENABLE_WEB=y
CONFIG_ORB_WEB_PORT=443
CONFIG_ORB_ENABLE_OTA=y
# CONFIG_ORB_OTA_ALLOW_HTTP is not set
CONFIG_ORB_OTA_URL_MAX_LEN=192
CONFIG_ORB_CONFIG_PERSIST_TO_NVS=y
CONFIG_ORB_CONFIG_NVS_NAMESPACE="orb_cfg"
# CONFIG_ORB_DEFAULT_MODE_OFFLINE_SCRIPTED is not set
CONFIG_ORB_DEFAULT_MODE_HYBRID_AI=y
# CONFIG_ORB_DEFAULT_MODE_INSTALLATION_SLAVE is not set
CONFIG_ORB_TOUCH_ONLY_LOG_MODE=y
CONFIG_HTTPD_MAX_REQ_HDR_LEN=2048
CONFIG_HTTPD_MAX_URI_LEN=1024
CONFIG_HTTPD_WS_SUPPORT=y
CONFIG_ESP_HTTPS_SERVER_ENABLE=y
CONFIG_MBEDTLS_EXTERNAL_MEM_ALLOC=y
# CONFIG_MBEDTLS_INTERNAL_MEM_ALLOC is not set
CONFIG_MBEDTLS_DYNAMIC_BUFFER=y
CONFIG_MBEDTLS_SSL_VARIABLE_BUFFER_LENGTH=y
```

## sdkconfig.defaults.dev
```kconfig
# Development overlay defaults (use on top of sdkconfig.defaults)
# Example:
#   idf.py -D SDKCONFIG_DEFAULTS="sdkconfig.defaults;sdkconfig.defaults.dev" reconfigure

CONFIG_ORB_ENABLE_MQTT=y
CONFIG_ORB_ENABLE_AI=y
CONFIG_ORB_ENABLE_OTA=y

CONFIG_ORB_AUDIO_TEST_TONE_ENABLE=y

CONFIG_ORB_TOUCH_ONLY_LOG_MODE=y
CONFIG_ORB_MEM_MONITOR_ENABLE=y
```
